## public/Kconfig
```kconfig
menu "Thread Config"

    #底盘控制线程选取
    config THREAD_CHASSIS_CONTROL
        bool "Enable chassis control thread"
        select THREAD_CAN_RECEIVE   #CAN控制线程
        select PID_CALCULATE        #PID
        default n

    #底盘种类选取
    if THREAD_CHASSIS_CONTROL
        choice
            prompt "select chassis kind"
            default MECANUM_WHEEL
            config MECANUM_WHEEL
                bool "mecanum"
            
            config OMNI_WHEEL
                bool "omnidirectional"
        endchoice
    endif
    
    #云台控制线程选取
    config THREAD_GIMBAL_CONTROL
        bool "Enable gimbal control thread"
        select THREAD_CAN_RECEIVE   #CAN接收线程
        select PID_CALCULATE        #PID
        select USING_GYRO           #陀螺仪
        default n

    #发射机构控制线程选取
    config THREAD_STRIKE_CONTRAL
        bool "Enable strike contral thread"
        select PID_CALCULATE        #PID
        select THREAD_CAN_RECEIVE   #CAN接收线程
        select MOTOR_CONTROL        #电机驱动文件
        default n
    
    #视觉自动瞄准
    config THREAD_AINBOT
        bool "Enable aim bot"
        select THREAD_CAN_RECEIVE   #CAN接收
        default n

    #CAN接收线程选取
    config THREAD_CAN_RECEIVE
        bool "Enable can receive thread"
        select BSP_USING_CAN
        select BSP_USING_CAN1
        select BSP_USING_CAN2
        default n

    #遥控器接收线程
    config THREAD_REMOTE
        bool "Enable remote thread"
        select BSP_USING_UART
        select BSP_USING_UART1
        default n

    #使用裁判系统
    config THREAD_REF_SYSTEM
        bool "Enable referee system"
        select BSP_USING_UART6
        select BSP_UART6_RX_USING_DMA
        default n

    #电机驱动文件
    config MOTOR_CONTROL
        bool "Using motor control"
        select PID_CALCULATE
        default n

    #PID文件
    config PID_CALCULATE
        bool "Using PID library"
        default n

    #陀螺仪文件选取
    config USING_GYRO
        bool "Using gyro module"
        select THREAD_CAN_RECEIVE   #依赖CAN接收线程
        default n

endmenu
```
